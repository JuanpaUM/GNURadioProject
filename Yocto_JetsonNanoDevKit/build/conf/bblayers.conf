## Yocto_JetsonNanoDevKit/build/conf/bblayers.conf
```bitbake
# POKY_BBLAYERS_CONF_VERSION is increased each time build/conf/bblayers.conf
# changes incompatibly
POKY_BBLAYERS_CONF_VERSION = "2"

BBPATH = "${TOPDIR}"
BBFILES ?= ""

BBLAYERS ?= " \
  /home/jpv/proy/Yocto/jetson-nano/meta-tegra \
  /home/jpv/proy/Yocto/jetson-nano/poky/meta \
  /home/jpv/proy/Yocto/jetson-nano/poky/meta-poky \
  /home/jpv/proy/Yocto/jetson-nano/poky/meta-yocto-bsp \
  /home/jpv/proy/Yocto/jetson-nano/meta-qt5 \
  /home/jpv/proy/Yocto/jetson-nano/meta-openembedded/meta-oe \
  /home/jpv/proy/Yocto/jetson-nano/meta-openembedded/meta-filesystems \
  /home/jpv/proy/Yocto/jetson-nano/meta-openembedded/meta-networking \
  /home/jpv/proy/Yocto/jetson-nano/meta-openembedded/meta-python \
  /home/jpv/proy/Yocto/jetson-nano/meta-sdr \
  /home/jpv/proy/Yocto/jetson-nano/meta-sdrproject \
  /home/jpv/proy/Yocto/jetson-nano/meta-tegra/contrib \
  /home/jpv/proy/Yocto/jetson-nano/meta-tegra-community \
  /home/jpv/proy/Yocto/jetson-nano/meta-blog \
  "
```

## Yocto_JetsonNanoDevKit/meta-blog/conf/layer.conf
```bitbake
# We have a conf and classes directory, add to BBPATH
BBPATH .= ":${LAYERDIR}"

# We have recipes-* directories, add to BBFILES
BBFILES += "${LAYERDIR}/recipes-*/*/*.bb \
            ${LAYERDIR}/recipes-*/*/*.bbappend"

BBFILE_COLLECTIONS += "meta-blog"
BBFILE_PATTERN_meta-blog = "^${LAYERDIR}/"
BBFILE_PRIORITY_meta-blog = "6"

LAYERDEPENDS_meta-blog = "core"
LAYERSERIES_COMPAT_meta-blog = "dunfell"
```

## Yocto_JetsonNanoDevKit/meta-sdrproject/conf/layer.conf
```bitbake
# We have a conf and classes directory, add to BBPATH
BBPATH .= ":${LAYERDIR}"

# We have recipes-* directories, add to BBFILES
BBFILES += "${LAYERDIR}/recipes-*/*/*.bb \
            ${LAYERDIR}/recipes-*/*/*.bbappend"

BBFILE_COLLECTIONS += "meta-sdrproject"
BBFILE_PATTERN_meta-sdrproject = "^${LAYERDIR}/"
BBFILE_PRIORITY_meta-sdrproject = "6"

LAYERDEPENDS_meta-sdrproject = "core"
LAYERSERIES_COMPAT_meta-sdrproject = "dunfell"
```
